#include <sys/mman.h>
#include <sys/types.h>
#include <sys/stat.h>
#include <fcntl.h>
#include <unistd.h>
#include <stdlib.h>
#include <stdint.h>
#include <stdio.h>
#include <string.h>
#include <errno.h>

int main(int argc, char **argv) {
	if (argc < 2) {
		fprintf(stderr, "usage: %s <gpio> <mode>\n", argv[0]);
		exit(1);
	}
	int pin = strtol(argv[1], NULL, 0);
	int devmem = open("/dev/mem", O_RDWR);
	unsigned pad_control_base = 0x44e10000;
	volatile uint32_t *padmap = (volatile uint32_t *)mmap(0, 0x2000, PROT_READ | PROT_WRITE, MAP_SHARED, devmem, pad_control_base);
	int pad_offset[32 * 4] = {
		0x148, 0x14c, 0x150, 0x154, 0x158, 0x15c, 0x160, 0x164, 0xd0, 0xd4, 0xd8, 0xdc, 0x178, 0x17c, 0x180, 0x184,
		0x11c, 0x120, 0x21c, 0x1b0, 0x1b4, 0x124, 0x20, 0x24, -1, -1, 0x28, 0x2c, 0x128, 0x144, 0x70, 0x74,

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		0x198, 0x19c, 0x1a0, 0x1a4, 0x1a8, 0x1ac, -1, -1, -1, -1, -1, -1, -1, -1, -1, -1
	};
	if (pad_offset[pin] < 0) {
		fprintf(stderr, "invalid pin %d\n", pin);
		exit(1);
	}
	printf("current: %x\n", padmap[(0x800 + pad_offset[pin]) / 4]);
	if (argc > 2) {
		int mode = strtol(argv[2], NULL, 0);
		int hack[2];
		if (pipe(hack)) {
			fprintf(stderr, "unable to create pipe: %s\n", strerror(errno));
			exit(1);
		}
		if (write(hack[1], &mode, 4) != 4)
			fprintf(stderr, "warning: short write\n");
		if (read(hack[0], (char *)&padmap[(0x800 + pad_offset[pin]) / 4], 4) != 4)
			fprintf(stderr, "warning: short read\n");
		printf("new: %x\n", padmap[(0x800 + pad_offset[pin]) / 4]);
	}
	return 0;
}
